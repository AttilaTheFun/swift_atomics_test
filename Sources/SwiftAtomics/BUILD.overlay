load("@build_bazel_rules_swift//swift:swift.bzl", "swift_library")

swift_library(
    name = "Atomics",
    copts = select({
        "@platforms//os:linux" : [
            "-experimental-skip-non-inlinable-function-bodies-without-types",
            "-enable-anonymous-context-mangled-names",
            "-disable-objc-interop",
        ],
        "//conditions:default" : [],
    }),
    defines = ["SWIFT_PACKAGE"],
    deps = [":AtomicsShims"],
    module_name = "Atomics",
    srcs = [
        "Sources/Atomics/AtomicInteger.swift",
        "Sources/Atomics/AtomicMemoryOrderings.swift",
        "Sources/Atomics/AtomicOptional.swift",
        "Sources/Atomics/AtomicOptionalRawRepresentable.swift",
        "Sources/Atomics/AtomicRawRepresentable.swift",
        "Sources/Atomics/AtomicStrongReference.swift",
        "Sources/Atomics/AtomicValue.swift",
        "Sources/Atomics/DoubleWord.swift",
        "Sources/Atomics/Unmanaged extensions.swift",
        "Sources/Atomics/autogenerated/AtomicBool.swift",
        "Sources/Atomics/autogenerated/AtomicLazyReference.swift",
        "Sources/Atomics/autogenerated/HighLevelTypes.swift",
        "Sources/Atomics/autogenerated/IntegerConformances.swift",
        "Sources/Atomics/autogenerated/PointerConformances.swift",
        "Sources/Atomics/autogenerated/Primitives.native.swift",
        "Sources/Atomics/autogenerated/Primitives.shims.swift",
    ],
    visibility = ["//visibility:public"],
)

cc_library(
    name = "AtomicsShims",
    copts = [
        "-fblocks",
        "-fobjc-arc",
        "-fPIC",
        "-fmodule-name=_AtomicsShims",
    ],
    defines = ["SWIFT_PACKAGE=1"],
    deps = [],
    hdrs = ["Sources/_AtomicsShims/include/_AtomicsShims.h"],
    includes = ["Sources/_AtomicsShims/include"],
    srcs = ["Sources/_AtomicsShims/src/_AtomicsShims.c"],
    tags = ["swift_module=_AtomicsShims"],
    textual_hdrs = ["Sources/_AtomicsShims/src/_AtomicsShims.c"],
    visibility = ["//visibility:public"],
)